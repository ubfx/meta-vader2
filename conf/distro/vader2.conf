## conf/distro/vader2.conf
```bitbake
DISTRO = "vader2"
DISTRO_NAME = "Vader2"
DISTRO_VERSION = "0.9.0"
DISTRO_CODENAME = "gatesgarth"

SDK_VERSION = "${@d.getVar('DISTRO_VERSION').replace('snapshot-${DATE}', 'snapshot')}"

MAINTAINER = "Felix Schneider <felix@fx-schneider.de>"

LOCALCONF_VERSION = "1"

DISTRO_VERSION[vardepsexclude] = "20210413"
SDK_VERSION[vardepsexclude] = "20210413"

DISTRO_EXTRA_RDEPENDS += "packagegroup-core-buildessential \
    openssh \
    openssh-scp \
    openssh-sftp-server \
    ca-certificates \
    cmake \
    curl \
    dosfstools \
    file \
    git \
    gzip \
    ifupdown \
    init-ifupdown \
    iputils \
    mmc-utils \
    ncurses \
    net-tools \
    perf \
    tar \
    time \
    tree \
    unzip \
    update-rc.d \
    wget \
    which \
    wilc \
    wilc3000-fw \
    zip \
    wpa-supplicant \
    wifi-autostart \
    iw \
    devmem2 \
    sudo \
    fpga-manager-script \
    clang \
    htop \
    xz \
    python3 \
    python3-aiohttp \
    python3-pip \
    net-tools \
    ntpdate \
    usbutils \
    gdb \
    gdbserver \
    strace \
    tzdata \
    localedef \
    libgomp \
    libgomp-dev \
"

DISTRO_FEATURES ?= "${DISTRO_FEATURES_DEFAULT} largefile"

SDK_NAME = "${DISTRO}-${TCLIBC}-${SDKMACHINE}-${IMAGE_BASENAME}-${TUNE_PKGARCH}-${MACHINE}"
SDKPATH = "/opt/${DISTRO}/${SDK_VERSION}"

BBFILE_PRIORITY_vader2-layer = "10"

INHERIT += "reproducible_build"

BB_SIGNATURE_HANDLER ?= "OEEquivHash"
BB_HASHSERVE ??= "auto"

PREFERRED_PROVIDER_virtual/boot-bin = "xilinx-bootbin"

PREFERRED_RPROVIDER_qemu-native = "qemu-xilinx-native"
PREFERRED_PROVIDER_qemu-native = "qemu-xilinx-native"

PREFERRED_RPROVIDER_nativesdk-qemu = "nativesdk-qemu-xilinx"
PREFERRED_PROVIDER_nativesdk-qemu = "nativesdk-qemu-xilinx"

PRE_BOOTENV += "setenv bootargs isolcpus=nohz,domain,managed_irq,1-3 nohz_full=1-3 hugepagesz=32M hugepages=0"

GLIBC_GENERATE_LOCALES = "de_DE.UTF-8 en_US.UTF-8"
IMAGE_LINGUAS = "en-us"
DEFAULT_TIMEZONE = "Europe/Berlin"
```

## conf/layer.conf
```bitbake
# We have a conf and classes directory, add to BBPATH
BBPATH .= ":${LAYERDIR}"

# We should have moved everything we need over so we don't need to
# rely on meta-avnet anymore
#AVNET = "${LAYERDIR}/../meta-avnet"

# We have recipes-* directories, add to BBFILES
BBFILES += "${LAYERDIR}/recipes-*/*/*.bb \
    ${LAYERDIR}/recipes-*/*/*.bbappend \
"

PREFERRED_PROVIDER_virtual/boot-bin = "xilinx-bootbin"

BBFILE_COLLECTIONS += "vader2"
BBFILE_PATTERN_vader2 = "^${LAYERDIR}/"
BBFILE_PRIORITY_meta-vader2 = "6"

# This should only be incremented on significant changes that will
# cause compatibility issues with other layers
LAYERVERSION_vader2 = "1"

LAYERDEPENDS_vader2 = "core"

LAYERSERIES_COMPAT_vader2 = "hardknott gatesgarth"

HDF_BASE = "file://"
HDF_PATH = "${TOPDIR}/system.xsa"
HDF_EXT = "xsa"

MACHINE = "u96v2-vader2"

ESW_VER = "2020.2"
```

## conf/machine/u96v2-vader2.conf
```bitbake
# Ultra96v2 Vader2

MACHINEOVERRIDES = "ultra96-zynqmp:${MACHINE}"

require conf/machine/include/soc-zynqmp.inc
require conf/machine/include/machine-xilinx-default.inc

MACHINE_FEATURES = ""

UBOOT_MACHINE = "xilinx_zynqmp_virt_defconfig"
# prevent U-Boot from deploying the boot.bin
SPL_BINARY = ""

SERIAL_CONSOLES ?= "115200;ttyPS0"

PMU_FIRMWARE_IMAGE_NAME ?= "pmu-firmware-zynqmp-pmu"
PMU_FIRMWARE_DEPLOY_DIR ?= "${TOPDIR}/pmutmp/deploy/images/zynqmp-pmu"

EXTRA_IMAGEDEPENDS += " \
        arm-trusted-firmware \
        u-boot-zynq-scr \
        virtual/bootloader \
        virtual/fsbl \
        virtual/pmu-firmware \
"

MACHINE_ESSENTIAL_EXTRA_RRECOMMENDS += "linux-firmware-wl18xx"

EXTRA_IMAGEDEPENDS_remove = "qemu-devicetrees"

PACKAGE_FEED_BASE_PATHS = "zzsoc"
PACKAGE_FEED_ARCHS = "all aarch64"

ESW_VER = "2020.2"
```
